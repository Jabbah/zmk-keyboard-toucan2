## boards/shields/toucan/Kconfig.shield
```kconfig
config SHIELD_TOUCAN_DONGLE
    def_bool $(shields_list_contains,toucan_dongle)

config SHIELD_TOUCAN_LEFT
    def_bool $(shields_list_contains,toucan_left)

# Left half built as a peripheral for use with the dongle
config SHIELD_TOUCAN_LEFT_PERIPHERAL
    def_bool $(shields_list_contains,toucan_left_peripheral)

config SHIELD_TOUCAN_RIGHT
    def_bool $(shields_list_contains,toucan_right)
```

## config/west.yml
```yaml
manifest:
  remotes:
    - name: zmkfirmware
      url-base: https://github.com/zmkfirmware
    - name: caksoylar
      url-base: https://github.com/caksoylar
    - name: geeksville
      url-base: https://github.com/geeksville
    - name: beekeeb
      url-base: https://github.com/beekeeb
    - name: albertclee
      url-base: https://github.com/alee0729
    - name: kot149
      url-base: https://github.com/kot149
    - name: jabbah
      url-base: https://github.com/jabbah
  projects:
    - name: zmk
      remote: zmkfirmware
      import: app/west.yml
      revision: v0.3
    - name: zmk-rgbled-widget
      remote: caksoylar
      revision: v0.3
    - name: zmk_driver_azoteq
      remote: beekeeb
      revision: main
    - name: zmk-input-zoom
      remote: beekeeb
      revision: main
    - name: zmk-dongle-screen
      remote: albertclee
      revision: main
    - name: zmk-scroll-snap
      remote: kot149
      revision: v1
    - name: zmk-input-inertia
      remote: jabbah
      revision: c4a6053f4e88b9333fe2d1d03acf92f1de735c68
  self:
    path: config
```

## dts/bindings/input/zmk,input-processor-scroll-latch.yaml
```yaml
description: >
  Keeps a two-finger scroll going briefly if one finger lifts. Cursor movement
  within timeout-ms of the last scroll wheel event is converted to scroll on the
  dominant axis; after that, or once all fingers lift, movement is left alone.

compatible: "zmk,input-processor-scroll-latch"

include: base.yaml

properties:
  "#input-processor-cells":
    type: int
    const: 0
    required: true

  track-remainders:
    type: boolean
    description: >
      Enable remainder tracking (not needed for scroll latching).

  timeout-ms:
    type: int
    default: 200
    description: >
      How long after the last scroll event cursor movement is still treated as
      scroll (i.e. the grace period after one finger lifts).

  invert-scroll-x:
    type: boolean
    description: >
      Negate X when converting to horizontal scroll. Match the trackpad driver's
      invert-scroll-x setting.

  invert-scroll-y:
    type: boolean
    description: >
      Negate Y when converting to vertical scroll. Match the trackpad driver's
      invert-scroll-y setting.
```
